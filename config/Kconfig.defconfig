## config/Kconfig.defconfig
```kconfig
if SHIELD_ERGONAUT_ONE_S_DONGLE

config ZMK_KEYBOARD_NAME
    default "Ergonaut One S C"

config ZMK_SPLIT_ROLE_CENTRAL
    default y

config ZMK_SPLIT_BLE_CENTRAL_PERIPHERALS
    default 2

endif

if SHIELD_ERGONAUT_ONE_S_DONGLE || SHIELD_ERGONAUT_ONE_S_LEFT || SHIELD_ERGONAUT_ONE_S_RIGHT

config ZMK_SPLIT
    default y

endif
```

## config/Kconfig.shield
```kconfig
config SHIELD_ERGONAUT_ONE_S
    bool

config SHIELD_ERGONAUT_ONE_S_DONGLE
    def_bool $(shields_list_contains,ergonaut_one_s_dongle)
    select ZMK_SPLIT_ROLE_CENTRAL
    select ZMK_SPLIT
    select SHIELD_ERGONAUT_ONE_S

config SHIELD_ERGONAUT_ONE_S_LEFT
    def_bool $(shields_list_contains,ergonaut_one_s_left)
    select ZMK_SPLIT
    select SHIELD_ERGONAUT_ONE_S

config SHIELD_ERGONAUT_ONE_S_RIGHT
    def_bool $(shields_list_contains,ergonaut_one_s_right)
    select ZMK_SPLIT
    select SHIELD_ERGONAUT_ONE_S
```
